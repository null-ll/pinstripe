/* Copyright 2021 null-ll
 *
 * This program is free software: you can redistribute it and/or modify
 * it under the terms of the GNU General Public License as published by
 * the Free Software Foundation, either version 2 of the License, or
 * (at your option) any later version.
 *
 * This program is distributed in the hope that it will be useful,
 * but WITHOUT ANY WARRANTY; without even the implied warranty of
 * MERCHANTABILITY or FITNESS FOR A PARTICULAR PURPOSE.  See the
 * GNU General Public License for more details.
 *
 * You should have received a copy of the GNU General Public License
 * along with this program.  If not, see <http://www.gnu.org/licenses/>.
 */

#include "pinstripe.h"
#include "ds1307.h"
#include <stdio.h>

#define ______ KC_TRNS

char wpm_str[10];

enum custom_keycodes {
    KC_TIMESET,
};

const uint16_t PROGMEM keymaps[][MATRIX_ROWS][MATRIX_COLS] = {
    [0] = LAYOUT_65_ansi(  /* base */
    /*  */
        KC_ESC,  KC_1,    KC_2,    KC_3,    KC_4,    KC_5,    KC_6,    KC_7,   KC_8,    KC_9,    KC_0,    KC_MINS, KC_EQL,  KC_BSPC, 
		KC_TAB,  KC_Q,    KC_W,    KC_E,    KC_R,    KC_T,    KC_Y,    KC_U,   KC_I,    KC_O,    KC_P,    KC_LBRC, KC_RBRC, KC_BSLS, 
		KC_CAPS, KC_A,    KC_S,    KC_D,    KC_F,    KC_G,    KC_H,    KC_J,   KC_K,    KC_L,    KC_SCLN, KC_QUOT, KC_ENT,           KC_MUTE, 
		KC_LSFT,          KC_Z,    KC_X,    KC_C,    KC_V,    KC_B,    KC_N,   KC_M,    KC_COMM, KC_DOT,  KC_SLSH, KC_RSFT,          KC_UP, 
		KC_LCTL, KC_LGUI, KC_LALT,                            KC_SPC,                   KC_RALT, MO(1),   KC_RCTL, KC_LEFT, KC_DOWN, KC_RGHT
    ),


    [1] = LAYOUT_65_ansi(  /* fn */
        /* esc     1        2        3        4        5        6        7        8        9        0        -        =       bspc           */
        KC_GRV,  KC_F1,   KC_F2,   KC_F3,   KC_F4,   KC_F5,   KC_F6,   KC_F7,   KC_F8,   KC_F9,   KC_F10,  KC_F11,  KC_F12,  KC_DEL,
        /* tab     Q        W        E        R        T        Y        U        I        O        P        [        ]        \             */
        ______,  ______,  ______,  ______,  RESET, KC_TIMESET, ______, ______,  KC_INS,  ______, KC_PSCR,  ______,  ______,  ______, 
        /* caps    A        S        D        F        G        H        J        K        L        ;        '       enter   rotary          */
        ______,  ______,  ______,  ______,  ______,  ______,  ______,  ______,  ______,  ______,  ______,  ______,  ______,           KC_MPLY,
        /* shift            Z        X        C        V        B        N        M        ,        .        /       shift              up   */
        ______,           ______,  ______,  ______,  ______,  ______,  ______,  ______,  ______,  ______,  ______,  ______,           ______,
        /* ctrl   gui      alt                                space                       alt       fn     ctrl      left     down    right  */
        ______,  ______,  ______,                             KC_SPC,                    ______,  ______,  ______,  ______,  ______,  ______
    )  
};

bool encoder_update_user(uint8_t index, bool clockwise) {
    if (index == 0) {
        if (clockwise) {
            tap_code(KC_VOLU);
        } else {
            tap_code(KC_VOLD);
        }
    }
    return true;
}

static uint32_t last_update = 0;
static uint8_t hours, minutes, seconds;
void matrix_scan_user(void) {
    uint32_t now = timer_read32();
    if (now - last_update > 500) {
        get_time(&hours, &minutes, &seconds);
        last_update = now;
    }
}

static bool setting_time = false;
static char new_time[6];
static uint8_t new_time_index = 0;

bool process_record_user(uint16_t keycode, keyrecord_t *record) {
    if (keycode == KC_TIMESET && record->event.pressed) {
        setting_time = true;
        new_time_index = 0;
    } else if (setting_time) {
        if (!record->event.pressed && keycode >= KC_1 && keycode <= KC_0) {
            new_time[new_time_index++] = (keycode == KC_0) ? 0 : keycode - KC_1 + 1;
            if (new_time_index == 6) {
                setting_time = false;
                set_time(
                        (new_time[0]) * 10 + (new_time[1]),
                        (new_time[2]) * 10 + (new_time[3]),
                        (new_time[4]) * 10 + (new_time[5])
                );
                for (int i = 0; i < 6; i++) {
                    tap_code(KC_BSPACE);
                }
            }
        }
    }
    return true;
}

#ifdef OLED_DRIVER_ENABLE

// WPM-responsive animation stuff here
#define IDLE_FRAMES 5
#define IDLE_SPEED 20  // below this wpm value your animation will idle

// #define PREP_FRAMES 1 // uncomment if >1

#define TAP_FRAMES 2
#define TAP_SPEED 40  // above this wpm value typing animation to trigger

#define ANIM_FRAME_DURATION 200  // how long each frame lasts in ms
// #define SLEEP_TIMER 60000 // should sleep after this period of 0 wpm, needs fixing
#define ANIM_SIZE 636  // number of bytes in array, minimize for adequate firmware size, max is 1024

uint32_t anim_timer = 0;
uint32_t anim_sleep = 0;
uint8_t  current_idle_frame = 0;
// uint8_t current_prep_frame = 0; // uncomment if PREP_FRAMES >1
uint8_t current_tap_frame = 0;

// Code containing pixel art, contains:
// 5 idle frames, 1 prep frame, and 2 tap frames

// To make your own pixel art:
// save a png/jpeg of an 128x32 image (resource: https://www.pixilart.com/draw )
// follow this guide up to and including "CONVERT YOUR IMAGE" https://docs.splitkb.com/hc/en-us/articles/360013811280-How-do-I-convert-an-image-for-use-on-an-OLED-display-
// replace numbers in brackets with your own
// if you start getting errors when compiling make sure you didn't accedentally delete a bracket
static void render_anim(void) {
    static const char PROGMEM idle[IDLE_FRAMES][ANIM_SIZE] = {{0x00, 0x00, 0x00, 0x00, 0x00, 0x00, 0x00, 0x00, 0x00, 0x00, 0x00, 0x00, 0x00,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 0x00,
                                                               0x00, 0x00, 0x00, 0x00, 0x00, 0x00, 0x00, 0x00, 0x00, 0x00, 0x00, 0x00, 0x00,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 0x01,
                                                               0x00, 0x00, 0x00, 0x00, 0x00, 0x00, 0x00, 0x00, 0x00, 0x00, 0x00, 0x00, 0x00,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 0x00,
                                                               0x00, 0x00, 0x00, 0x00, 0x00, 0x00, 0x00, 0x00, 0x00, 0x00, 0x00, 0x00, 0x00,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 0x00, 0x00},
                                                              {0x00, 0x00, 0x00, 0x00, 0x00, 0x00, 0x00, 0x00, 0x00, 0x00, 0x00, 0x00, 0x00,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 0x00,
                                                               0x00, 0x00, 0x00, 0x00, 0x00, 0x00, 0x00, 0x00, 0x00, 0x00, 0x00, 0x00, 0x00,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 0x01,
                                                               0x00, 0x00, 0x00, 0x00, 0x00, 0x00, 0x00, 0x00, 0x00, 0x00, 0x00, 0x00, 0x00,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 0x00,
                                                               0x00, 0x00, 0x00, 0x00, 0x00, 0x00, 0x00, 0x00, 0x00, 0x00, 0x00, 0x00, 0x00,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 0x00, 0x00},
                                                              {0x00, 0x00, 0x00, 0x00, 0x00, 0x00, 0x00, 0x00, 0x00, 0x00, 0x00, 0x00, 0x00,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 0x00,
                                                               0x00, 0x00, 0x00, 0x00, 0x00, 0x00, 0x00, 0x00, 0x00, 0x00, 0x00, 0x00, 0x00,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 0x01,
                                                               0x00, 0x00, 0x00, 0x00, 0x00, 0x00, 0x00, 0x00, 0x00, 0x00, 0x00, 0x00, 0x00,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 0x00,
                                                               0x00, 0x00, 0x00, 0x00, 0x00, 0x00, 0x00, 0x00, 0x00, 0x00, 0x00, 0x00, 0x00,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 0x00, 0x00},
                                                              {0x00, 0x00, 0x00, 0x00, 0x00, 0x00, 0x00, 0x00, 0x00, 0x00, 0x00, 0x00, 0x00,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 0x00,
                                                               0x00, 0x00, 0x00, 0x00, 0x00, 0x00, 0x00, 0x00, 0x00, 0x00, 0x00, 0x00, 0x00,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 0x01,
                                                               0x00, 0x00, 0x00, 0x00, 0x00, 0x00, 0x00, 0x00, 0x00, 0x00, 0x00, 0x00, 0x00,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 0x00,
                                                               0x00, 0x00, 0x00, 0x00, 0x00, 0x00, 0x00, 0x00, 0x00, 0x00, 0x00, 0x00, 0x00,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 0x00, 0x00},
                                                              {0x00, 0x00, 0x00, 0x00, 0x00, 0x00, 0x00, 0x00, 0x00, 0x00, 0x00, 0x00, 0x00,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 0x00,
                                                               0x00, 0x00, 0x00, 0x00, 0x00, 0x00, 0x00, 0x00, 0x00, 0x00, 0x00, 0x00, 0x00,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 0x01,
                                                               0x00, 0x00, 0x00, 0x00, 0x00, 0x00, 0x00, 0x00, 0x00, 0x00, 0x00, 0x00, 0x00,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 0x00,
                                                               0x00, 0x00, 0x00, 0x00, 0x00, 0x00, 0x00, 0x00, 0x00, 0x00, 0x00, 0x00, 0x00,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 0x00, 0x00}};
    static const char PROGMEM prep[][ANIM_SIZE]            = {{0x00, 0x00, 0x00, 0x00, 0x00, 0x00, 0x00, 0x00, 0x00, 0x00, 0x00, 0x00, 0x00,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 0x00,
                                                    0x00, 0x00, 0x00, 0x00, 0x00, 0x00, 0x00, 0x00, 0x00, 0x00, 0x00, 0x00,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 0x01,
                                                    0x00, 0x00, 0x00, 0x00, 0x00, 0x00, 0x00, 0x00, 0x00, 0x00, 0x00, 0x00,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 0x00,
                                                    0x00, 0x00, 0x00, 0x00, 0x00, 0x00, 0x00, 0x00, 0x00, 0x00, 0x00, 0x00,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 0x00, 0x00}};
    static const char PROGMEM tap[TAP_FRAMES][ANIM_SIZE]   = {
        {0x00, 0x00, 0x00, 0x00, 0x00, 0x00, 0x00, 0x00, 0x00, 0x00, 0x00, 0x00, 0x00,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 0x00,
         0x00, 0x00, 0x00, 0x00, 0x00, 0x00, 0x00, 0x00, 0x00, 0x00, 0x00, 0x00,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 0x01,
         0x00, 0x00, 0x00, 0x00, 0x00, 0x00, 0x00, 0x00, 0x00, 0x00, 0x00, 0x00,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 0x00,
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         0x00, 0x00, 0x00, 0x00, 0x00, 0x00, 0x00, 0x00, 0x00, 0x00, 0x00, 0x00,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 0x00, 0x00},
    };

    // assumes 1 frame prep stage
    void animation_phase(void) {
        if (get_current_wpm() <= IDLE_SPEED) {
            current_idle_frame = (current_idle_frame + 1) % IDLE_FRAMES;
            oled_write_raw_P(idle[abs((IDLE_FRAMES - 1) - current_idle_frame)], ANIM_SIZE);
        }
        if (get_current_wpm() > IDLE_SPEED && get_current_wpm() < TAP_SPEED) {
            // oled_write_raw_P(prep[abs((PREP_FRAMES-1)-current_prep_frame)], ANIM_SIZE); // uncomment if IDLE_FRAMES >1
            oled_write_raw_P(prep[0], ANIM_SIZE);  // remove if IDLE_FRAMES >1
        }
        if (get_current_wpm() >= TAP_SPEED) {
            current_tap_frame = (current_tap_frame + 1) % TAP_FRAMES;
            oled_write_raw_P(tap[abs((TAP_FRAMES - 1) - current_tap_frame)], ANIM_SIZE);
        }
    }
    if (get_current_wpm() != 000) {
        oled_on();  // not essential but turns on animation OLED with any alpha keypress
        if (timer_elapsed32(anim_timer) > ANIM_FRAME_DURATION) {
            anim_timer = timer_read32();
            animation_phase();
        }
        anim_sleep = timer_read32();
    } else {
        if (timer_elapsed32(anim_sleep) > OLED_TIMEOUT) {
            oled_off();
        } else {
            if (timer_elapsed32(anim_timer) > ANIM_FRAME_DURATION) {
                anim_timer = timer_read32();
                animation_phase();
            }
        }
    }
}

oled_rotation_t oled_init_user(oled_rotation_t rotation) {
    return OLED_ROTATION_0;
}

void display_time(void) {

    // static const char PROGMEM colon[4][3] = {
    //     { 0x8C, 0x8D, 0 },
    //     { 0xAC, 0xAD, 0 },
    //     { 0xCC, 0xCD, 0 },
    //     { 0xEC, 0xED, 0 }
    // };

    static const char PROGMEM nums[11][3][16] = {
        { 
            { 0,  0,248,252,254, 14,  7,  7,  7,  7, 14,254,252,248,  0,  0, },
            { 0,  0,255,255,255,  0,  0,  0,  0,  0,  0,255,255,255,  0,  0, },
            { 0,  0, 31,127,255,240,224,224,224,224,240,255,127, 31,  0,  0, },
        },
        { 
            { 0,  0,  0,  0, 24, 28,254,255,255,255,  0,  0,  0,  0,  0,  0, },  
            { 0,  0,  0,  0,  0,  0,255,255,255,255,  0,  0,  0,  0,  0,  0, },
            { 0,  0,  0,  0,  0,  0,255,255,255,255,  0,  0,  0,  0,  0,  0, },
        },
        { 
            { 0,  0,248,252,254, 15,  7,  7,  7,  7, 15,255,254,252,  0,  0, },
            { 0,  0,  0,  0,  0,  0,128,192,224,240,248,127, 63, 31,  0,  0, },
            { 0,  0,248,252,254,255,239,231,227,225,224,224,224,224,  0,  0, },
        },
        { 
            { 0,  0,248,252,254, 15,  7,  7,  7,  7, 15,254,252,248,  0,  0, },
            { 0,  0,  0,  0,  0,  0,  0, 28, 30, 62,127,247,243,225,  0,  0, },
            { 0,  0, 60,124,252,240,224,224,224,224,240,255,127, 63,  0,  0, },
        },
        { 
            { 0,  0,  0,  0,  0,192,240,252, 63, 31,255,255,255,  0,  0,  0, },
            { 0,  0,224,252,255, 31,  3,  0,  0,  0,255,255,255,  0,  0,  0, },
            { 0,  0,  7,  7,  7,  7,  7,  7,  7,  7,255,255,255,  7,  0,  0, },
        },
        { 
            { 0,  0,255,255,255,  7,  7,  7,  7,  7,  7,  7,  7,  7,  0,  0, },
            { 0,  0, 15, 15, 15, 14,  7,  7,  7,  7, 15,254,252,248,  0,  0, },
            { 0,  0, 60,124,252,240,224,224,224,224,240,255,127, 63,  0,  0, },
        },
        { 
            { 0,  0,248,252,254, 15,  7,  7,  7,  7, 15, 31, 30, 28,  0,  0, },
            { 0,  0,255,255,255, 28, 14, 14, 14, 14, 30,252,248,240,  0,  0, },
            { 0,  0, 63,127,255,240,224,224,224,224,240,255,127, 63,  0,  0, },
        },
        { 
            { 0,  0,  7,  7,  7,  7,  7,  7,  7,  7,  7,255,255,255,  0,  0, },
            { 0,  0,  0,  0,  0,  0,  0,128,224,248,254,127, 15,  3,  0,  0, },
            { 0,  0,  0,  0,  0,  0,254,255,255,  7,  1,  0,  0,  0,  0,  0, },
        },
        { 
            { 0,  0,252,254,255, 15,  7,  7,  7,  7, 15,255,254,252,  0,  0, },
            { 0,  0,195,231,255,126, 60, 60, 60, 60,126,255,231,195,  0,  0, },
            { 0,  0, 63,127,255,240,224,224,224,224,240,255,127, 63,  0,  0, },
        },
        { 
            { 0,  0,248,252,254, 15,  7,  7,  7,  7, 15,254,252,248,  0,  0, },
            { 0,  0,  7, 15, 31, 30, 28, 28, 28, 28, 14,255,255,255,  0,  0, },
            { 0,  0, 56,120,248,240,224,224,224,224,240,255,127, 63,  0,  0, },
        },
        { 
            { 0,  0,  0,  0,  0,  0,192,192,192,192,  0,  0,  0,  0,  0,  0, },
            { 0,  0,  0,  0,  0,  0,  1,  1,  1,  1,  0,  0,  0,  0,  0,  0, },
            { 0,  0,  0,  0,  0,  0,  7,  7,  7,  7,  0,  0,  0,  0,  0,  0, },
        },
    };

    // static const char PROGMEM numbers[10][4][3] = {
    //     {   // 0
    //         { 0x01, 0x02, 0 }, 
    //         { 0x21, 0x22, 0 },
    //         { 0x41, 0x42, 0 },
    //         { 0x61, 0x62, 0 }
    //     },
    //     {   // 1
    //         { 0x03, 0x04, 0 },
    //         { 0x23, 0x24, 0 },
    //         { 0x43, 0x44, 0 },
    //         { 0x63, 0x64, 0 }
    //     },
    //     {   // 2
    //         { 0x05, 0x06, 0 },
    //         { 0x25, 0x26, 0 },
    //         { 0x45, 0x46, 0 },
    //         { 0x65, 0x66, 0 }
    //     },
    //     {   // 3
    //         { 0x07, 0x08, 0 },
    //         { 0x27, 0x28, 0 },
    //         { 0x47, 0x48, 0 },
    //         { 0x67, 0x68, 0 }
    //     },
    //     {   // 4
    //         { 0x80, 0x81, 0 },
    //         { 0xA0, 0xA1, 0 },
    //         { 0xC0, 0xC1, 0 },
    //         { 0xE0, 0xE1, 0 }
    //     },
    //     {   // 5
    //         { 0x82, 0x83, 0 },
    //         { 0xA2, 0xA3, 0 },
    //         { 0xC2, 0xC3, 0 },
    //         { 0xE2, 0xE3, 0 }
    //     },
    //     {   // 6
    //         { 0x84, 0x85, 0 },
    //         { 0xA4, 0xA5, 0 },
    //         { 0xC4, 0xC5, 0 },
    //         { 0xE4, 0xE5, 0 }
    //     },
    //     {   // 7
    //         { 0x86, 0x87, 0 },
    //         { 0xA6, 0xA7, 0 },
    //         { 0xC6, 0xC7, 0 },
    //         { 0xE6, 0xE7, 0 }
    //     },
    //     {   // 8
    //         { 0x88, 0x89, 0 },
    //         { 0xA8, 0xA9, 0 },
    //         { 0xC8, 0xC9, 0 },
    //         { 0xE8, 0xE9, 0 }
    //     },
    //     {   // 9
    //         { 0x8A, 0x8B, 0 },
    //         {  0xAA, 0xAB, 0 },
    //         { 0xCA, 0xCB, 0 },
    //         { 0xEA, 0xEB, 0 }
    //     },
    // };

    int time[5];
    time[0] = hours / 10;
    time[1] = hours % 10;
    time[3] = minutes / 10;
    time[4] = minutes % 10;
    for(int i = 0 ; i < 5; i++) {
        for (int j = 0; j < 3; j++) {
            oled_set_cursor(3 * i + 4, j);
            if (i == 2) {
                oled_write_raw_P(nums[10][j], sizeof(nums[10][j]));
            } else {
                oled_write_raw_P(nums[time[i]][j], sizeof(nums[time[i]][j]));
            }
        }
    }
    // for(int i = 0; i < 5; i++) {
    //     oled_set_cursor(3 * i + 4, 0);
    //     if (i == 2) {
    //         oled_write_raw(nums[10], sizeof(nums[10]));
    //     } else {
    //         oled_write_raw(nums[time[i]], sizeof(nums[time[i]]));
    //     }
    // }

}

void oled_task_user(void) {
    display_time();
    oled_set_cursor(0, 4);
    render_anim();  // renders pixelart
}
#endif